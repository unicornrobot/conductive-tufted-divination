// Sensor0 Touch 0 = I04  - GREEN WIRE - ORANGE TUFT
// Sensor1 Touch 6 = IO14 - RED WIRE - RED TUFT
// Sensor2 Touch 3 = IO15 - BLUE WIRE - BLUE TUFT
// Sensor3 Touch 5 = IO12 - BLACK WIRE - LIME TUFT
// Sensor4 Touch 4 = IO13 - YELLOW WIRE - PINK TUFT

#include <Adafruit_NeoPixel.h>

//LED pin
#define PIN 2 //gpio2

int range0,range1,range2,range3,range4 = 0;
 
// When we setup the NeoPixel library, we tell it how many pixels, and which pin to use to send signals.
// Note that for older NeoPixel strips you might need to change the third parameter--see the strandtest
Adafruit_NeoPixel pixels = Adafruit_NeoPixel(12, PIN, NEO_GRB + NEO_KHZ800);
 


#include <TouchLib.h>
/*
 * Code generated by TouchLib SemiAutoTuning.
 *
 * Hardware configuration:
 *   sensor 0: type: capacitive (touchRead()) method), pin 4
 */

/*
 *  Number of sensors. For capacitive sensors: needs to be a minimum of 2. When
 * using only one sensor, set N_SENSORS to 2 and use an unused analog input pin for the second
 * sensor. For 2 or more sensors you don't need to add an unused analog input.
 */
#define N_SENSORS                       5

/*
 * Number of measurements per sensor to take in one cycle. More measurements
 * means more noise reduction / spreading, but is also slower.
 */
#define N_MEASUREMENTS_PER_SENSOR       16

/* tlSensors is the actual object that contains all the sensors */
TLSensors<N_SENSORS, N_MEASUREMENTS_PER_SENSOR> tlSensors;





void setup() {
  // put your setup code here, to run once:
Serial.begin(9600);
pixels.begin(); // This initializes the NeoPixel library.
pixels.setBrightness(20);
pixels.clear();
/*
         
        /*
         * Configuration for sensor 0:
         * Type: capacitive (touchRead() method)
         * Pin: 4 - GREEN WIRE
         */
        tlSensors.initialize(0, TLSampleMethodTouchRead);
        tlSensors.data[0].tlStructSampleMethod.touchRead.pin =         4;
        tlSensors.data[0].releasedToApproachedThreshold =              558;
        tlSensors.data[0].approachedToReleasedThreshold =              502;
        tlSensors.data[0].approachedToPressedThreshold =               9586;
        tlSensors.data[0].pressedToApproachedThreshold =               8627;
        tlSensors.data[0].calibratedMaxDelta =                         20929;
        tlSensors.data[0].filterType = TLStruct::filterTypeAverage;

        /*
         * Configuration for sensor 1:
         * Type: capacitive (touchRead() method)
         * Pin: 14
         */
        tlSensors.initialize(1, TLSampleMethodTouchRead);
        tlSensors.data[1].tlStructSampleMethod.touchRead.pin =         14;
        tlSensors.data[1].releasedToApproachedThreshold =              321;
        tlSensors.data[1].approachedToReleasedThreshold =              289;
        tlSensors.data[1].approachedToPressedThreshold =               12927;
        tlSensors.data[1].pressedToApproachedThreshold =               11634;
        tlSensors.data[1].calibratedMaxDelta =                         27378;
        tlSensors.data[1].filterType = TLStruct::filterTypeAverage;

        /*
         * Configuration for sensor 2:
         * Type: capacitive (touchRead() method)
         * Pin: 15
         */
        tlSensors.initialize(2, TLSampleMethodTouchRead);
        tlSensors.data[2].tlStructSampleMethod.touchRead.pin =         15;
        tlSensors.data[2].releasedToApproachedThreshold =              290;
        tlSensors.data[2].approachedToReleasedThreshold =              1262;
        tlSensors.data[2].approachedToPressedThreshold =               11690;
        tlSensors.data[2].pressedToApproachedThreshold =               10521;
        tlSensors.data[2].calibratedMaxDelta =                         24154;
        tlSensors.data[2].filterType = TLStruct::filterTypeAverage;

        /*
         * Configuration for sensor 3:
         * Type: capacitive (touchRead() method)
         * Pin: 12
         */
        tlSensors.initialize(3, TLSampleMethodTouchRead);
        tlSensors.data[3].tlStructSampleMethod.touchRead.pin =         12;
        tlSensors.data[3].releasedToApproachedThreshold =              240;
        tlSensors.data[3].approachedToReleasedThreshold =              1077;
        tlSensors.data[3].approachedToPressedThreshold =               9581;
        tlSensors.data[3].pressedToApproachedThreshold =               10123;
        tlSensors.data[3].calibratedMaxDelta =                         20087;
        tlSensors.data[3].filterType = TLStruct::filterTypeAverage;

        /*
         * Configuration for sensor 4:
         * Type: capacitive (touchRead() method)
         * Pin: 13
         */
        tlSensors.initialize(4, TLSampleMethodTouchRead);
        tlSensors.data[4].tlStructSampleMethod.touchRead.pin =         13;
        tlSensors.data[4].releasedToApproachedThreshold =              1034;
        tlSensors.data[4].approachedToReleasedThreshold =              931;
        tlSensors.data[4].approachedToPressedThreshold =               13270;
        tlSensors.data[4].pressedToApproachedThreshold =               11943;
        tlSensors.data[4].calibratedMaxDelta =                         28374;
        tlSensors.data[4].filterType = TLStruct::filterTypeAverage;
        
        if (tlSensors.error) {
                Serial.println("Error detected during initialization of TouchLib. This is "
                       "probably a bug; please notify the author.");
                while (1);
        }
/*
        Serial.println("Calibrating sensors...");
        while(tlSensors.anyButtonIsCalibrating()) {
                tlSensors.sample();
        }
        Serial.println("Calibration done...");
*/
}

void loop() {



 
//pixels.show(); // This sends the updated pixel color to the hardware.
//delay(200); // Delay for a period of time (in milliseconds).




//int var1 = int(random(100));

tlSensors.sample(); // <-- Take a series of new samples for all sensors //
/*
Serial.print(tlSensors.getDelta(0));Serial.print(",");
Serial.print(tlSensors.getDelta(1));Serial.print(",");
Serial.print(tlSensors.getDelta(2));Serial.print(",");
Serial.print(tlSensors.getDelta(3));Serial.print(",");
Serial.println(tlSensors.getDelta(4));

Serial.print(tlSensors.getRaw(0));Serial.print(",");
Serial.print(tlSensors.getRaw(1));Serial.print(",");
Serial.print(tlSensors.getRaw(2));Serial.print(",");
Serial.print(tlSensors.getRaw(3));Serial.print(",");
Serial.print(tlSensors.getRaw(4));Serial.print("          ");
*/

//change values to between 0 and 100
//** calibrated from raw data - released/pressed

int range0 = map(tlSensors.getRaw(0), 4300, 3000, 0, 100); // (input, min, max, rangemin, rangemax)
int range1 = map(tlSensors.getRaw(1), 5000, 3000, 0, 100);
int range2 = map(tlSensors.getRaw(2), 4000, 2000, 0, 100);
int range3 = map(tlSensors.getRaw(3), 4500, 2500, 0, 100);
int range4 = map(tlSensors.getRaw(4), 4000, 3000, 0, 100);

//cap min and max 
if (range0 < 0) {range0 = 0;}; if (range0 >100) {range0 = 100;}
if (range1 < 0) {range1 = 0;}; if (range1 >100) {range1 = 100;}
if (range2 < 10) {range2 = 0;}; if (range2 >100) {range2 = 100;}
if (range3 < 0) {range3 = 0;}; if (range3 >100) {range3 = 100;}
if (range4 < 11) {range4 = 0;}; if (range4 >100) {range4 = 100;}

//output RAW sensor values
/*
Serial.print(tlSensors.getRaw(0));Serial.print(",");
Serial.print(tlSensors.getRaw(1));Serial.print(",");
Serial.print(tlSensors.getRaw(2));Serial.print(",");
Serial.print(tlSensors.getRaw(3));Serial.print(",");
Serial.println(tlSensors.getRaw(4));
*/

//LEDS
// pixels.Color takes RGB values, from 0,0,0 up to 255,255,255

/*
for (int i = 0; i < 2; i++) { //SECTION 1 - (PIXEL 0/1)
  pixels.setPixelColor(i, pixels.Color(255,102,0)); // ORANGE.
  //pixels.setBrightness(range0);
  //Serial.println(range0);
  pixels.show();
}

for (int j = 2; j < 4; j++) { //SECTION 2
  //pixels.setBrightness(range1);
  pixels.setPixelColor(j, pixels.Color(255,0,0)); // RED. 
  pixels.show();
}

for (int k = 4; k < 6; k++) { //SECTION 3 
  //pixels.setBrightness(range2);
  pixels.setPixelColor(k, pixels.Color(17,147,174)); // TEAL.
  pixels.show();
}

for (int l = 6; l < 8; l++) { //SECTION 4
  //pixels.setBrightness(range3);
  pixels.setPixelColor(l, pixels.Color(239,255,0)); // LIME.
  pixels.show();
}
for (int m = 8; m < 10; m++) { //SECTION 5
  //pixels.setBrightness(range4);
  pixels.setPixelColor(m, pixels.Color(255,0,213)); // PINK
  pixels.show();
}
*/
int ledBar0 = map(range0, 0,100, 0,6); 
int ledBar1 = map(range1, 0,100, 6,12);
//Serial.print(ledBar0);Serial.print(" ");

pixels.clear();
for (int i = 0; i < ledBar0 ; i++){
  pixels.setPixelColor(i, pixels.Color(255,102,0)); // ORANGE
}
pixels.show();

for (int j = 6; j < ledBar1 ; j++){
  pixels.setPixelColor(j, pixels.Color(255,0,0)); // RED
}
pixels.show();


//output scaled (0-100)
Serial.print(range0);Serial.print(",");
Serial.print(range1);Serial.print(",");
Serial.print(range2);Serial.print(",");
Serial.print(range3);Serial.print(",");
Serial.println(range4);


//delay(100);
}
