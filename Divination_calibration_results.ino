#include <TouchLib.h>

/*
 * Code generated by TouchLib SemiAutoTuning.
 *
 * Hardware configuration:
 *   sensor 0: type: capacitive (touchRead()) method), pin 4
 *   sensor 1: type: capacitive (touchRead()) method), pin 14
 *   sensor 2: type: capacitive (touchRead()) method), pin 15
 *   sensor 3: type: capacitive (touchRead()) method), pin 12
 *   sensor 4: type: capacitive (touchRead()) method), pin 13
 */

/*
 *  Number of sensors. For capacitive sensors: needs to be a minimum of 2. When
 * using only one sensor, set N_SENSORS to 2 and use an unused analog input pin for the second
 * sensor. For 2 or more sensors you don't need to add an unused analog input.
 */
#define N_SENSORS                       5

/*
 * Number of measurements per sensor to take in one cycle. More measurements
 * means more noise reduction / spreading, but is also slower.
 */
#define N_MEASUREMENTS_PER_SENSOR       16

/* tlSensors is the actual object that contains all the sensors */
TLSensors<N_SENSORS, N_MEASUREMENTS_PER_SENSOR> tlSensors;

void setup()
{
        Serial.begin(9600);

        #if IS_ATMEGA32U4
        while(!Serial); /* Required for ATmega32u4 processors */
        #endif

        /* Delay to make sure serial monitor receives first message */
        delay(500);
        Serial.println();
        Serial.println();
        Serial.println("Switching baudrate to 115200. Make sure to adjust baudrate in serial monitor as well!");
        Serial.println();
        Serial.println();
        Serial.end();

        /*
         * Switch baudrate to highest baudrate available. With higher baudrate,
         * CPU has more time left to do capacitive sensing and thus get better
         * signal quality.
         */
        Serial.begin(115200);
        delay(500);
        Serial.println();
        Serial.println();

        /*
         * Configuration for sensor 0:
         * Type: capacitive (touchRead() method)
         * Pin: 4
         */
        tlSensors.initialize(0, TLSampleMethodTouchRead);
        tlSensors.data[0].tlStructSampleMethod.touchRead.pin =         4;
        tlSensors.data[0].releasedToApproachedThreshold =              143;
        tlSensors.data[0].approachedToReleasedThreshold =              129;
        tlSensors.data[0].approachedToPressedThreshold =               17017;
        tlSensors.data[0].pressedToApproachedThreshold =               15315;
        tlSensors.data[0].calibratedMaxDelta =                         34283;
        tlSensors.data[0].filterType = TLStruct::filterTypeAverage;

        /*
         * Configuration for sensor 1:
         * Type: capacitive (touchRead() method)
         * Pin: 14
         */
        tlSensors.initialize(1, TLSampleMethodTouchRead);
        tlSensors.data[1].tlStructSampleMethod.touchRead.pin =         14;
        tlSensors.data[1].releasedToApproachedThreshold =              150;
        tlSensors.data[1].approachedToReleasedThreshold =              135;
        tlSensors.data[1].approachedToPressedThreshold =               19813;
        tlSensors.data[1].pressedToApproachedThreshold =               17832;
        tlSensors.data[1].calibratedMaxDelta =                         39890;
        tlSensors.data[1].filterType = TLStruct::filterTypeAverage;

        /*
         * Configuration for sensor 2:
         * Type: capacitive (touchRead() method)
         * Pin: 15
         */
        tlSensors.initialize(2, TLSampleMethodTouchRead);
        tlSensors.data[2].tlStructSampleMethod.touchRead.pin =         15;
        tlSensors.data[2].releasedToApproachedThreshold =              2;
        tlSensors.data[2].approachedToReleasedThreshold =              2;
        tlSensors.data[2].approachedToPressedThreshold =               20370;
        tlSensors.data[2].pressedToApproachedThreshold =               18333;
        tlSensors.data[2].calibratedMaxDelta =                         40825;
        tlSensors.data[2].filterType = TLStruct::filterTypeAverage;

        /*
         * Configuration for sensor 3:
         * Type: capacitive (touchRead() method)
         * Pin: 12
         */
        tlSensors.initialize(3, TLSampleMethodTouchRead);
        tlSensors.data[3].tlStructSampleMethod.touchRead.pin =         12;
        tlSensors.data[3].releasedToApproachedThreshold =              120;
        tlSensors.data[3].approachedToReleasedThreshold =              108;
        tlSensors.data[3].approachedToPressedThreshold =               20646;
        tlSensors.data[3].pressedToApproachedThreshold =               18581;
        tlSensors.data[3].calibratedMaxDelta =                         41516;
        tlSensors.data[3].filterType = TLStruct::filterTypeAverage;

        /*
         * Configuration for sensor 4:
         * Type: capacitive (touchRead() method)
         * Pin: 13
         */
        tlSensors.initialize(4, TLSampleMethodTouchRead);
        tlSensors.data[4].tlStructSampleMethod.touchRead.pin =         13;
        tlSensors.data[4].releasedToApproachedThreshold =              118;
        tlSensors.data[4].approachedToReleasedThreshold =              107;
        tlSensors.data[4].approachedToPressedThreshold =               20269;
        tlSensors.data[4].pressedToApproachedThreshold =               18242;
        tlSensors.data[4].calibratedMaxDelta =                         40693;
        tlSensors.data[4].filterType = TLStruct::filterTypeAverage;

        if (tlSensors.error) {
                Serial.println("Error detected during initialization of TouchLib. This is "
                       "probably a bug; please notify the author.");
                while (1);
        }

        Serial.println("Calibrating sensors...");
        while(tlSensors.anyButtonIsCalibrating()) {
                tlSensors.sample();
        }
        Serial.println("Calibration done...");
}

void print_sensor_state(int n)
{
        char s[32] = {'\0'};

        Serial.print(" #");
        Serial.print(n);
        Serial.print(": ");
        Serial.print(tlSensors.isCalibrating(n));
        Serial.print(" ");
        Serial.print(tlSensors.isReleased(n));
        Serial.print(" ");
        Serial.print(tlSensors.isApproached(n));
        Serial.print(" ");
        Serial.print(tlSensors.isPressed(n));
        Serial.print(" ");
        Serial.print(tlSensors.getState(n));
        Serial.print(" ");
        Serial.print(tlSensors.getStateLabel(n));
        memset(s, '\0', sizeof(s));
        memset(s, ' ', 22 - strlen(tlSensors.getStateLabel(n)));
        Serial.print(s);
}

#define BAR_LENGTH                     58 /* <-- Change this to print longer or shorter visualizations */

void loop(void)
{
        int k;

        int n = 0; /* <-- Change this number to view a different sensor */

        tlSensors.sample(); /* <-- Take a series of new samples for all sensors */

        tlSensors.printBar(n, BAR_LENGTH); /* <-- Print the visualization */

        print_sensor_state(n); /* <-- Print summary of sensor n */

        /* For capacitive + resistive sensors: k is the sensor that sensor n is paired with */
        k = tlSensors.findSensorPair(n, (n + 1) % N_SENSORS);
        if (k > -1) {
                print_sensor_state(k); /* <-- Print summary of sensor k */
        }
        Serial.println("");
}
